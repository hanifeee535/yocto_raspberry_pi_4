## meta-my_custom_layer/conf/layer.conf
```bitbake
# We have a conf and classes directory, add to BBPATH
BBPATH .= ":${LAYERDIR}"

# We have recipes-* directories, add to BBFILES
BBFILES += "${LAYERDIR}/recipes-*/*/*.bb \
            ${LAYERDIR}/recipes-*/*/*.bbappend"

BBFILE_COLLECTIONS += "meta-my_custom_layer"
BBFILE_PATTERN_meta-my_custom_layer = "^${LAYERDIR}/"
BBFILE_PRIORITY_meta-my_custom_layer = "6"

LAYERDEPENDS_meta-my_custom_layer = "core"
LAYERSERIES_COMPAT_meta-my_custom_layer = "kirkstone"
```
